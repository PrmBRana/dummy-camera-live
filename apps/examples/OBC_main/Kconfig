## apps/examples/camera_launcher/Kconfig
```kconfig
config EXAMPLES_CAMERA_LAUNCHER
	bool "Camera Launcher"
	default n
	---help---
		Start camera and subscriber together using launcher app
```

## apps/examples/littlefs/Kconfig
```kconfig
#
# For a description of the syntax of this configuration file,
# see the file kconfig-language.txt in the NuttX tools repository.
#

config EXAMPLES_LITTLEFS
	tristate "LittleFS example"
	default n
	select BOARDCTL if !EXAMPLES_LITTLEFS_BLOCKDEVICE
	select BOARDCTL_MKRD if !EXAMPLES_LITTLEFS_BLOCKDEVICE
	---help---
		Enable the LittleFS example

if EXAMPLES_LITTLEFS

config EXAMPLES_LITTLEFS_BLOCKDEVICE
	bool "Use block device"
	default n
	---help---
		Use an existing block device to mount. If EXAMPLES_LITTLEFS_BLOCKDEVICE
		is not selected, then a RAM disk will be configured for the test.

if EXAMPLES_LITTLEFS_BLOCKDEVICE

config EXAMPLES_LITTLEFS_DEVNAME
	string "Block device name"
	default "/dev/mtdblock0"
	---help---
		The name of the user-provided block device to mount.  Must be
		provided if EXAMPLES_LITTLEFS_BLOCKDEVICE is selected.

endif # EXAMPLES_LITTLEFS_BLOCKDEVICE

if !EXAMPLES_LITTLEFS_BLOCKDEVICE

config EXAMPLES_LITTLEFS_NSECTORS
	int "RAM disk number of sectors"
	default 2048
	---help---
		The number of "sectors" in the RAM disk used when
		EXAMPLES_LITTLEFS_BLOCKDEVICE is not selected.

config EXAMPLES_LITTLEFS_SECTORSIZE
	int "RAM disk sector size"
	default 512
	---help---
		The size of each sectors in the RAM disk used when
		EXAMPLES_LITTLEFS_BLOCKDEVICE is not selected.

config EXAMPLES_LITTLEFS_RAMDEVNO
	int "RAM disk device number"
	default 0
	---help---
		The RAM device minor number used to mount the RAM disk used when
		EXAMPLES_LITTLEFS_BLOCKDEVICE is not selected.  The default is zero
		(meaning that "/dev/ram0" will be used).

endif # !EXAMPLES_LITTLEFS_BLOCKDEVICE
endif # EXAMPLES_LITTLEFS
```
